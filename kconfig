## kconfig
```kconfig
choice
	prompt "Controller family"
	default FAMILY_LPC11XX

	config FAMILY_LPC11XX
		bool "NXP LPC11xx"

	config FAMILY_LPC11EXX
		bool "NXP LPC11Exx"

	config FAMILY_LPC13XX
		bool "NXP LPC13xx"

	config FAMILY_LPC17XX
		bool "NXP LPC175x and LPC176x"

	config FAMILY_LPC43XX
		bool "NXP LPC43xx"
endchoice

config CORE
	string
	default m0          if FAMILY_LPC11XX || FAMILY_LPC11EXX
	default m3          if FAMILY_LPC13XX || FAMILY_LPC17XX
	default m4          if FAMILY_LPC43XX

config CORE_TYPE
	string
	default cortex      if FAMILY_LPC11XX || FAMILY_LPC11EXX || FAMILY_LPC13XX || FAMILY_LPC17XX || FAMILY_LPC43XX

config PLATFORM
	string
	default lpc11xx     if FAMILY_LPC11XX
	default lpc11exx    if FAMILY_LPC11EXX
	default lpc13xx     if FAMILY_LPC13XX
	default lpc17xx     if FAMILY_LPC17XX
	default lpc43xx     if FAMILY_LPC43XX

config PLATFORM_TYPE
	string
	default nxp         if FAMILY_LPC11XX || FAMILY_LPC11EXX || FAMILY_LPC13XX || FAMILY_LPC17XX || FAMILY_LPC43XX

menu "Drivers"

config DRIVERS_DS18B20
	bool "DS18B20"
	default y

config DRIVERS_RGB_LED
	bool "RGB LED driver"
	default y

config DRIVERS_SOFTWARE_PWM
	bool "Software PWM driver"
	default y

config DRIVERS_USB_MOUSE
	bool "USB Mouse"
	default y

config DRIVERS_DISPLAYS_HD44780
	bool "HD44780 series"
	default y

config DRIVERS_DISPLAYS_S6D1121
	bool "S6D1121 display"
	default y

config DRIVERS_DISPLAYS_ST7735
	bool "ST7735 display"
	default y

config DRIVERS_PLATFORM_NXP_MEMORY_BUS_GPIO
	bool "Memory bus on GPIO"
	default y

config DRIVERS_PLATFORM_NXP_MEMORY_BUS_DMA
	bool "Memory bus on DMA"
	default y
	depends on FAMILY_LPC17XX || FAMILY_LPC43XX

endmenu

menu "Build options"

choice
	prompt "Optimization level"
	default OPTIMIZATIONS_DISABLED

	config OPTIMIZATIONS_DISABLED
		bool "None"

	config OPTIMIZATIONS_SIZE
		bool "Size"

	config OPTIMIZATIONS_FULL
		bool "Full"

	config OPTIMIZATIONS_DEBUG
		bool "Debug"
endchoice

config ASSERTIONS
	bool "Enable assertions"
	depends on (OPTIMIZATIONS_DISABLED || OPTIMIZATIONS_DEBUG)
	default y

config LTO
	bool "Link Time Optimization"
	depends on (OPTIMIZATIONS_SIZE || OPTIMIZATIONS_FULL)
	default y

config FPU
	bool "FPU"
	default y
	help
	  This enables Floating Point Unit.
	depends on FAMILY_LPC43XX

endmenu
```
